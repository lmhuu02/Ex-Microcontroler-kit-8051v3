
/*
******************************************************
*time: 2023 
*embedded 8051 by langauge c.
*ex2: control display lcd 126x64
*******************************************************
*/
#include <REGX51.H>
#include <stdio.h>

#define DATA P0

sbit CS1 = P2^5;
sbit CS2 = P2^6;
sbit RS = P2^2;
sbit RW = P2^3;
sbit EN = P2^4;

int i,j;

code unsigned char Logo_ICTU_am_ban [] = {
0x00, 0x00, 0x00, 0x00, 0x00, 0x00, 0x00, 0x00, 0x00, 0x00, 0x00, 0x00, 0x80, 0xC0, 0xE0, 0xE0,
0xF0, 0xF0, 0xF8, 0xF8, 0xFC, 0xFC, 0xFC, 0xFE, 0xFE, 0xFE, 0x7E, 0x7F, 0x7F, 0x7F, 0x7F, 0xFF,
0xFF, 0xFF, 0xFF, 0xFF, 0xFF, 0xFE, 0xFE, 0xFE, 0xFE, 0xFC, 0xFC, 0xFC, 0xF8, 0xF8, 0xF0, 0xF0,
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0x07, 0x07, 0x03, 0x01, 0x00, 0x00, 0x00, 0x00, 0x00, 0x00, 0x00, 0x00, 0x00, 0x00, 0x00, 0x00
};


//ham delay
void delay(int t){
	while(t--);
}

//ham gui lenh cho glcd
void GLCD_Comd(unsigned char cmnd){
	DATA = cmnd;
	RS = 0;
	RW = 0;
	EN = 1;
	delay(10);
	EN = 0;
}

//ham chon page cua glcd.
void select_page(unsigned char page){
	if(page){
		CS1 = 0;
		CS2 = 1;
	}else{
		CS1 = 1;
		CS2 = 0;
	}
}

//ham gui du lieu
void GLCD_Data(unsigned char dt){
	DATA = dt;
	RS = 1;
	RW = 0;
	EN = 1;
	delay(10);
	EN = 0;
}

//ham khoi tao glcd
void GLCD_Init(){
	unsigned char Comd[5] = {0xc0, 0xb8,0x40, 0x3f};
	select_page(1);
	for(i = 0; i < 4; i++){
		GLCD_Comd(Comd[i]);
	}
	select_page(0);
	for(i = 0; i < 4; i++){
		GLCD_Comd(Comd[i]);
	}
}

//hien thi hinh anh cho trang 0 va 1
void GLCD_PutPicture(const unsigned char *ip){
	int Page = 0, i = 1;
	int Column = 0;
	for(Page = 0; Page < 8; Page++){
		select_page(0);
		GLCD_Comd(0xb8 |Page);
		GLCD_Comd(0x40);
		for(Column = 0; Column < 128; Column++){
			if(Column ==64){
				select_page(1);
				GLCD_Comd(0xb8|Page);
				GLCD_Comd(0x40);
			}
			GLCD_Data(*ip++);
		}
	}
}

//chuong trinh chinh
void main(voidi){
	GLCD_Init();
	delay(2);
	GLCD_PutPicture(Logo_ICTU_am_ban);
	while(1){
		
	}
}